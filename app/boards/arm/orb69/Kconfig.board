## app/boards/arm/orb69/Kconfig.defconfig
```kconfig
if BOARD_ORB69

config ZMK_KEYBOARD_NAME
    default "orb69"

if USB_DEVICE_STACK

config USB_NRFX
    default y

endif # USB_DEVICE_STACK

config BT_CTLR
    default BT

config ZMK_BLE
    default y

config ZMK_USB
    default y

config LED
    default y

config LED_WIDGET_INTERVAL_MS
    int "Minimum wait duration between two blinks in ms"
    default 200

config LED_WIDGET_BATTERY_LEVEL_CRITICAL
    int "Critical battery level percentage"
    default 10

endif # BOARD_ORB69
```

## app/drivers/sensor/adns3530/Kconfig
```kconfig
# Copyright (c) 2023 The ZMK Contributors
# SPDX-License-Identifier: MIT

menuconfig ADNS3530
	bool "ADNS3530 Mouse Sensor"
	default y
	depends on DT_HAS_AVAGO_ADNS3530_ENABLED
	depends on SPI
	help
	  Enable mouse sensor

		The ADNS3530 is a 8-bit optical mouse sensor

if ADNS3530

choice
	prompt "Trigger mode"
	default ADNS3530_TRIGGER_NONE
	help
	  Specify the type of triggering to be used by the driver.

config ADNS3530_TRIGGER_NONE
	bool "No trigger"

config ADNS3530_TRIGGER_GLOBAL_THREAD
	bool "Use global thread"
	depends on GPIO
	select ADNS3530_TRIGGER

config ADNS3530_TRIGGER_OWN_THREAD
	bool "Use own thread"
	depends on GPIO
	select ADNS3530_TRIGGER

endchoice

config ADNS3530_TRIGGER
	bool

config ADNS3530_THREAD_PRIORITY
	int "Thread priority"
	depends on ADNS3530_TRIGGER_OWN_THREAD
	default 10
	help
	  Priority of thread used by the driver to handle interrupts.

config ADNS3530_THREAD_STACK_SIZE
	int "Thread stack size"
	depends on ADNS3530_TRIGGER_OWN_THREAD
	default 1024
	help
	  Stack size of thread used by the driver to handle interrupts.

endif # ADNS3530
```

## app/drivers/zephyr/dts/bindings/sensor/avago,adns3530.yaml
```yaml
# Copyright (c) 2023 The ZMK Contributors
# SPDX-License-Identifier: MIT
description: |
  Sensor driver for the avago adns 3530 optical mouse sensoe
compatible: "avago,adns3530"

include: spi-device.yaml

properties:
  cs-gpios:
    type: phandle-array
    required: true
    description: chip select pin for the sensor
  motswk-gpios:
    type: phandle-array
    required: false
    description: interrupt pin for motion
  disable-rest:
    type: boolean
    description: disables mouse rest mode, will decrease battery life
    required: false
```
